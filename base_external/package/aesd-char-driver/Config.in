## base_external/package/aesd-char-driver/Config.in
```kconfig
config BR2_PACKAGE_AESD_CHAR_DRIVER
	bool "aesd-char-driver"
	help
	  Includes the aesd character device files.
```

## base_external/package/ldd/Config.in
```kconfig
config BR2_PACKAGE_LDD
	bool "ldd"
	help
	  Loads scull components and misc-modules as per the instructions in assignment.
```
